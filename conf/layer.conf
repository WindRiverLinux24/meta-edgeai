## conf/layer.conf
```bitbake
# We have a conf and classes directory, append to BBPATH
BBPATH .= ":${LAYERDIR}"

# We have a recipes directory, add to BBFILES
BBFILES += "${LAYERDIR}/recipes*/*/*.bb ${LAYERDIR}/recipes*/*/*.bbappend"

BBFILE_COLLECTIONS += "meta-edgeai"
BBFILE_PATTERN_meta-edgeai := "^${LAYERDIR}/"

# We keep the priority higher than all others
BBFILE_PRIORITY_meta-edgeai = "13"

LAYERDEPENDS_meta-edgeai = "core meta-ti-bsp meta-ti-extras"

LAYERSERIES_COMPAT_meta-edgeai = "scarthgap"
BBMASK += "${LAYERDIR}/recipes-kernel/linux/"
BBMASK += "${LAYERDIR}/recipes-core"
BBMASK += "${LAYERDIR}/recipes-bsp"
BBMASK += "${LAYERDIR}/wic"
BBMASK += "${LAYERDIR}/recipes-demos"
BBMASK += "${LAYERDIR}/recipes-tisdk/edgeai-dependencies"
BBMASK += "${LAYERDIR}/recipes-tisdk/edgeai-components/(edgeai-gui-app_0.1.bb|edgeai-init.bb|tisdk-uenv.bbappend)"
RECIPE_LIST_REASON:meta-edgeai = "You are about to enable third-party components, there is additional third-part \
licensing involved, please consult your legal department should you have questions regarding the licensing terms and obligations."

require conf/distro/include/edgeai-source-ipk.inc

TI_TEST_TI_TOOLS:remove:pn-ti-test = "videnc-test-app"

KERNEL_DEVICETREE_PREFIX:append:j721s2 = "ti/k3-j721s2"
KERNEL_DEVICETREE_PREFIX:append:j784s4 = "ti/k3-j784s4"
KERNEL_DEVICETREE_PREFIX:append:j721e = "ti/k3-j721e"
```
